
#define sw_num 5 //определяем количество выключателей

//объявляем пины выключателей в массиве. Выключатель замыкает пин GND
byte sw_led[sw_num] = {5,4,14,12,13}; // через запятую указываем номера пинов, к которым подключим выключатели

//объявляем пины реле в массиве. 
byte sw_rele[sw_num] = {15,2,0,16,1}; // через запятую указываем номера пинов, к которым подключим реле

boolean swWasUp[sw_num] ;  // была ли кнопка отпущена?
boolean releEnabled[sw_num] ;  // включен ли свет?

void setup()
{
Serial.begin(115200);
for (int i=0; i < sw_num; i++){ //заполняем массивы состояний
      swWasUp[i]  = true;  // была ли кнопка отпущена?;
      releEnabled[i] = false;  // включен ли свет?
      
      pinMode(sw_rele[i], OUTPUT); // прописываем режим работы выходов
      pinMode(sw_led[i], INPUT_PULLUP); // прописываем режим работы входов
      digitalWrite(sw_rele[i], HIGH); //первоначальное выключение или включение света
      
}// заполнили массивы состояний
} // setup

void loop()
{
    // определить момент «клика» несколько сложнее, чем факт того,
  // что кнопка сейчас просто нажата. Для определения клика мы
  // сначала понимаем, отпущена ли кнопка прямо сейчас...
  boolean swIsUp[sw_num] ;
  
  for (int i=0; i < sw_num; i++){ 

    swIsUp[i] = digitalRead(sw_led[i]);
  // ...если «кнопка была отпущена и (&&) не отпущена сейчас»...
  if (swWasUp[i] && !swIsUp[i]) {
    // ...может это «клик», а может и ложный сигнал (дребезг),
    // возникающий в момент замыкания/размыкания пластин кнопки,
    // поэтому даём кнопке полностью «успокоиться»...
    delay(10);
      // ...и считываем сигнал снова
    swIsUp[i] = digitalRead(sw_led[i]);
    if (!swIsUp[i]) {  // если она всё ещё нажата...
      // ...это клик! Переворачиваем сигнал светодиода
      releEnabled[i] = !releEnabled[i];
      digitalWrite(sw_rele[i], releEnabled[i]);
    } // конец второго условия
  
  } // конец первого условия
 
  // запоминаем последнее состояние кнопки для новой итерации
  swWasUp[i] = swIsUp[i];
  } //for
} // loop


